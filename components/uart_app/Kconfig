## components/uart_app/Kconfig
```kconfig
menu "UART Application Configuration"

    config UART_APP_ENABLED
        bool "Enable UART"
        default y
        help
            When enabled, uart_app_start() initializes the UART peripheral
            and creates the receive task. Disable to skip UART entirely.

    config UART_APP_BAUD_RATE
        int "UART baud rate"
        default 115200
        range 300 4000000
        help
            Baud rate used by the UART communication.

    config UART_APP_TX_GPIO
        int "UART TX GPIO number"
        default 2
        help
            GPIO number used as the UART TX pin.

    config UART_APP_RX_GPIO
        int "UART RX GPIO number"
        default 1
        help
            GPIO number used as the UART RX pin.

    config UART_APP_PERIODIC_SEND
        bool "Send 0xAA periodically"
        default y
        help
            When enabled, a task sends the byte 0xAA over UART at a fixed
            interval (see UART_APP_SEND_INTERVAL_MS).

    config UART_APP_SEND_INTERVAL_MS
        int "Periodic send interval (ms)"
        default 1000
        range 10 60000
        depends on UART_APP_PERIODIC_SEND
        help
            Interval in milliseconds between two periodic 0xAA transmissions.

endmenu
```

## drivers/mqtt_driver/Kconfig
```kconfig
menu "MQTT Driver Configuration"

    config MQTT_DRIVER_ENABLED
        bool "Enable MQTT driver"
        default y
        help
            When enabled, mqtt_driver_start() creates the MQTT client and
            connects to the configured broker. Disable to skip MQTT entirely.

    choice MQTT_DRIVER_CERT_VALIDATION
        prompt "Certificate validation method"
        default MQTT_DRIVER_CERT_VALIDATE_BUNDLE
        help
            Choose how the broker's TLS server certificate is validated.
            - Certificate bundle (default).
            - Embedded certificate

        config MQTT_DRIVER_CERT_VALIDATE_BUNDLE
            bool "Certificate bundle"

        config MQTT_DRIVER_CERT_VALIDATE_MOSQUITTO_CA
            bool "Embedded Certificate"

    endchoice

    config MQTT_DRIVER_BROKER_URI
        string "MQTT broker URI"
        default "mqtts://test.mosquitto.org:8886"
        default "mqtts://test.mosquitto.org:8883" if MQTT_DRIVER_CERT_VALIDATE_MOSQUITTO_CA
        help
            URI to the MQTT broker.
            When using the example broker the port must be set to 8883 if testing
            embedded certificate.

    config MQTT_DRIVER_BROKER_CERTIFICATE_OVERRIDE
        string "Broker certificate override (PEM body)"
        default ""
        help
            Optional: override server certificate by embedding a PEM constructed
            from this base64 body. Leave empty to use the certificate bundle or the
            embedded Mosquitto CA. Provide only the base64 payload without the
            BEGIN/END markers.

    config MQTT_DRIVER_BROKER_CERTIFICATE_OVERRIDDEN
        bool
        default y if MQTT_DRIVER_BROKER_CERTIFICATE_OVERRIDE != ""

    config MQTT_DRIVER_ENABLE_ONENET_AUTH
        bool "Enable OneNET auth (username/clientId/token)"
        default n
        help
            When enabled, the MQTT CONNECT packet carries OneNET credentials:
            username = product ID, clientId = device name,
            password = token generated from the device key (HMAC-SHA1).
            Only applies to the OneNET IoT platform.

    if MQTT_DRIVER_ENABLE_ONENET_AUTH

        config MQTT_DRIVER_PRODUCT_ID
            string "OneNET product ID"
            default ""
            help
                Product ID assigned by the OneNET console (used as username).

        config MQTT_DRIVER_DEVICE_NAME
            string "OneNET device name"
            default ""
            help
                Device name created in the OneNET console (used as clientId).

        config MQTT_DRIVER_DEVICE_KEY
            string "OneNET device key (base64)"
            default ""
            help
                Device key (accessKey) from the OneNET console, base64 encoded.
                Used to compute the access token (password).

        config MQTT_DRIVER_TOKEN_VALID_SECONDS
            int "OneNET token valid seconds"
            default 3600
            range 60 31536000
            help
                Validity of the generated token. The device clock must be
                synced (SNTP) so that the expiration time is in the future.

        config MQTT_DRIVER_PROPERTY_ID
            string "OneNET thing-model property identifier"
            default "temp"
            help
                Property identifier (属性标识) defined in the product thing
                model (物模型) on the OneNET console. Reported values use this
                identifier in the OneJSON payload, e.g. {"params":{"temp":...}}.

    endif

endmenu
```

## drivers/uart_driver/Kconfig
```kconfig
menu "UART Driver Configuration"

    config UART_DRIVER_ENABLED
        bool "Enable UART driver"
        default y
        help
            When enabled, uart_driver_start() initializes the UART peripheral
            and creates the receive task. Disable to skip UART entirely.

    config UART_DRIVER_BAUD_RATE
        int "UART baud rate"
        default 115200
        range 300 4000000
        help
            Baud rate used by the UART communication.

    config UART_DRIVER_TX_GPIO
        int "UART TX GPIO number"
        default 2
        help
            GPIO number used as the UART TX pin.

    config UART_DRIVER_RX_GPIO
        int "UART RX GPIO number"
        default 1
        help
            GPIO number used as the UART RX pin.

endmenu
```
